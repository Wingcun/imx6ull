/dts-v1/;

#include "imx6ull-alientek-emmc.dts"
#include <dt-bindings/gpio/gpio.h>

/ {
    platform_probe_test: platform-probe-test {
        compatible = "training,imx6ull-platform-probe";
        led-gpios = <&gpio1 3 GPIO_ACTIVE_LOW>;
        status = "okay";
    };
};